// Arduino code to listen for pixel data in serial format from a PC/RaspberryPi,
// and relay it to an LED matrix or strip

#define ADAFRUIT_MATRIX 77
#define LED_TYPE ADAFRUIT_MATRIX // 2801 | 2811 | ADAFRUIT_MATRIX
#define WIDTH 64
#define HEIGHT 32
#define COLOR_DEPTH 48 // internal color depth to use in SmartMatrix: 24 or 48bit
#define BLINK_PIN 13
#define OUTPUT_FPS_INTERVAL 5000
#define USE_GAMMA_CONVERSION

#define p(...) Serial.print(__VA_ARGS__)

#if (LED_TYPE==2811)
  #include <OctoWS2811.h>
  #define LEDS_PER_STRIP (WIDTH*HEIGHT/8)

  DMAMEM int displayMemory[LEDS_PER_STRIP*6];
  int drawingMemory[LEDS_PER_STRIP*6];
  OctoWS2811 leds(LEDS_PER_STRIP, displayMemory, drawingMemory, WS2811_GRB | WS2811_800kHz);
#elif (LED_TYPE==2801)
  #include "FastLED.h"
  #define CLOCK_PIN 2 // data line 1
  #define DATA_PIN 14 // data line 2
  CRGB leds[WIDTH*HEIGHT];
#elif (LED_TYPE==ADAFRUIT_MATRIX)
  #include <SmartMatrix3.h>

  const uint8_t kMatrixWidth = 64;        // known working: 32, 64, 96, 128
  const uint8_t kMatrixHeight = 32;       // known working: 16, 32, 48, 64
  const uint8_t kRefreshDepth = 36;       // known working: 24, 36, 48
  const uint8_t kDmaBufferRows = 4;       // known working: 2-4, use 2 to save memory, more to keep from dropping frames and automatically lowering refresh rate
  const uint8_t kPanelType = SMARTMATRIX_HUB75_32ROW_MOD16SCAN;   // use SMARTMATRIX_HUB75_16ROW_MOD8SCAN for common 16x32 panels
  const uint8_t kMatrixOptions = (SMARTMATRIX_OPTIONS_NONE);      // see http://docs.pixelmatix.com/SmartMatrix for options
  const uint8_t kBackgroundLayerOptions = (SM_BACKGROUND_OPTIONS_NONE);

  SMARTMATRIX_ALLOCATE_BUFFERS(matrix, kMatrixWidth, kMatrixHeight, kRefreshDepth, kDmaBufferRows, kPanelType, kMatrixOptions);
  SMARTMATRIX_ALLOCATE_BACKGROUND_LAYER(backgroundLayer, kMatrixWidth, kMatrixHeight, COLOR_DEPTH, kBackgroundLayerOptions);
#endif

#define BUFFER_SIZE 6500 * 3
static byte buffer[BUFFER_SIZE];

#ifdef USE_GAMMA_CONVERSION
//gamma=4
//static const uint16_t gammaTable[] = {0x0,0x0,0x0,0x0,0x0,0x0,0x0,0x0,0x0,0x0,0x0,0x0,0x0,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0xf817,0xfc05};
//gamma=3.5
static const uint16_t gammaTable[] = {0x0,0x0,0x0,0x0,0x0,0x0,0x0,0x0,0x0,0x1,0x1,0x1,0x1,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0xf910,0xfc83};
//gamma=3
//static const uint16_t gammaTable[] = {0x0,0x0,0x0,0x0,0x0,0x0,0x1,0x1,0x2,0x3,0x4,0x5,0x7,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0xfa0b,0xfd02};
#endif

void updateLEDs()
{
#if (LED_TYPE==2811)
    leds.show();
#elif (LED_TYPE==2801)
    FastLED.show();
    //memset(leds, 0, sizeof(leds));
#elif (LED_TYPE==ADAFRUIT_MATRIX)
    backgroundLayer.swapBuffers();
#endif
}

void setup() {
  pinMode(BLINK_PIN, OUTPUT);

	// sanity check delay - allows reprogramming if accidently blowing power w/leds
  delay(2000);

  Serial.begin(115200);
  Serial.setTimeout(0);

#if (LED_TYPE==2811)
  leds.begin();
#elif (LED_TYPE==2801)
  FastLED.addLeds<WS2801, DATA_PIN, CLOCK_PIN, BRG, DATA_RATE_MHZ(4)>(leds, WIDTH*HEIGHT);
  memset(leds, 0, sizeof(leds));
#elif (LED_TYPE==ADAFRUIT_MATRIX)
  matrix.addLayer(&backgroundLayer);
  matrix.setRefreshRate(180);
  matrix.begin();
  matrix.setBrightness(255);
  backgroundLayer.enableColorCorrection(false);
#endif
}


void outputFPS() {
  static uint32_t lastFpsOutputTime = millis();
  static int32_t fpsOutputCount = 0;

  // output effective FPS every so often
  fpsOutputCount++;
  uint32_t fpsOutputTimeDiff = millis() - lastFpsOutputTime;
  if (fpsOutputTimeDiff > OUTPUT_FPS_INTERVAL) {
    digitalWrite(BLINK_PIN, HIGH);
    delayMicroseconds(1000);
    digitalWrite(BLINK_PIN, LOW);

    int32_t fps = fpsOutputCount * 1000UL / fpsOutputTimeDiff;
    p(fps);

// #if (LED_TYPE==ADAFRUIT_MATRIX)
//     char value[] = "00";
//     value[0] = '0' + fps / 100;
//     value[1] = '0' + (fps % 100) / 10;
//     value[2] = '0' + fps % 10;    
//     matrix.drawForegroundString(12, matrix.getScreenHeight()-1 -5, value, true);
//     matrix.displayForegroundDrawing();
//     matrix.clearForeground();
// #endif
    fpsOutputCount = 0;
    lastFpsOutputTime = millis();
  }
}

static int pix=0;

void loop() {
  int nbytes = Serial.readBytes((char*)buffer, BUFFER_SIZE);
  if (nbytes > WIDTH*HEIGHT*3+1) {
    Serial.print("Bytes:"); 
    Serial.println(nbytes);
  }

  for (int i=0; i<nbytes; i++) {
    int c = (int)buffer[i];
    if (c == 255) {
      updateLEDs();
      //outputFPS();
      //Serial.print(1);

      pix = 0;
      break; // may skip some frames that are backed up
    } else {
#if (LED_TYPE==2811)
#elif (LED_TYPE==2801)
    #if COLOR_DEPTH == 24
      leds[pix/3] += (c) << (8*(pix%3));
    #else // 48 bit
      leds[pix/6] += (c) << (8*(pix%6));
    #endif
#elif (LED_TYPE==ADAFRUIT_MATRIX)
    #if COLOR_DEPTH == 24
      // the order expected is:
      // 24bit:
      // RGBRGB
      // 111222    <- pixel#
      int pos = pix / 3;
      RGB_TYPE(COLOR_DEPTH)& col = backgroundLayer.backBuffer()[pos];
      switch (pix % 3) {
        case 0:
          col.red = c;
          break;
        case 1:
          col.green = c;
          break;
        case 2:
          col.blue = c;
          break;
      }
    #elif COLOR_DEPTH == 48 && defined(USE_GAMMA_CONVERSION)
      // the order expected is:
      // 24bit:
      // RGBRGB
      // 111222    <- pixel#
      int pos = pix / 3;
      RGB_TYPE(COLOR_DEPTH)& col = backgroundLayer.backBuffer()[pos];
      switch (pix % 3) {
        case 0:
          col.red = gammaTable[c];
          break;
        case 1:
          col.green = gammaTable[c];
          break;
        case 2:
          col.blue = gammaTable[c];
          break;
      }
    #else // 48 bit
      // the order expected is:
      // 48bit:
      // RRGGBBRRGGBB
      // 1 1 1 2 2 2    <- pixel#
      int pos = pix / 6;
      RGB_TYPE(COLOR_DEPTH)& col = backgroundLayer.backBuffer()[pos];
      switch (pix % 6) {
        case 0:
          col.red = (col.red & 0xFF00) + c;
          break;
        case 1:
          col.red = (c << 8) + (col.red & 0xFF);
          break;
        case 2:
          col.green = (col.green & 0xFF00) + c;
          break;
        case 3:
          col.green = (c << 8) + (col.green & 0xFF);
          break;
        case 4:
          col.blue = (col.blue & 0xFF00) + c;
          break;
        case 5:
          col.blue = (c << 8) + (col.blue & 0xFF);
          break;
      }
    #endif      
#endif

      pix++;
    }
  }
}
